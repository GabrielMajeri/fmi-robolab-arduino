const int JS_PIN_SW = 10;
const int JS_PIN_X = A0;
const int JS_PIN_Y = A1;

int buttonState = 0;
int xValue = 0;
int yValue = 0;

bool incremented = false;
int counter = 0;

void setup() {
  Serial.begin(9600);
  pinMode(JS_PIN_SW, INPUT_PULLUP);
  
}

void loop() {
  buttonState = digitalRead(JS_PIN_SW);
  xValue = analogRead(JS_PIN_X);
  yValue = analogRead(JS_PIN_Y);
  
  if (yValue < 300) {
    if (!incremented) {
      --counter;
    }
    incremented = true;
  } else if (yValue > 700) {
    if (!incremented) {
      ++counter;
    }
    incremented = true;
  } else {
    incremented = false;
  }
  
  Serial.print("Count: ");
  Serial.print(counter);
  /
  Serial.print(" | Switch: ");
  Serial.print(buttonState);
  Serial.print(" | X: ");
  Serial.print(xValue);
  Serial.print(" | Y: ");
  Serial.print(yValue);
  */
  Serial.println();
  delay(100);
}
