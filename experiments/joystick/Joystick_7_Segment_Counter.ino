const byte pinA = 2;
const byte pinB = 3;
const byte pinC = 4;
const byte pinD = 5;
const byte pinE = 6;
const byte pinF = 7;
const byte pinG = 8;
const byte pinDP = 9;

const byte JS_PIN_SW = 10;
const byte JS_PIN_X = A0;
const byte JS_PIN_Y = A1;

const int DISPLAY_SIZE = 8;
const byte segments[DISPLAY_SIZE] = {
  pinA, pinB, pinC, pinD, pinE, pinF, pinG, pinDP
};

const byte digits[][7] = {
  {1, 1, 1, 1, 1, 1, 0}, // 0
  {0, 1, 1, 0, 0, 0, 0}, // 1
  {1, 1, 0, 1, 1, 0, 1}, // 2
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  {1, 1, 1, 1, 0, 1, 1}, // 9
};

int counter = 0;
byte dotState = 0;

int buttonState = 0;
int xValue = 0;
int yValue = 0;
bool incremented = 0;

void clearDisplay() {
  for (int i = 0; i < DISPLAY_SIZE; ++i) {
    digitalWrite(segments[i], LOW);
  }
}

void displayDigit(byte digit) {
  byte* line = digits[digit];
  for (int i = 0; i < DISPLAY_SIZE - 1; ++i) {
    byte segment = segments[i];
    byte state = line[i];
    
    digitalWrite(segment, state);
  }
  
  digitalWrite(pinDP, dotState);
}

void setup() {
  Serial.begin(9600);
  for (int i = 0; i < DISPLAY_SIZE; ++i) {
    byte segment = segments[i];
    pinMode(segment, OUTPUT);
  }
}

void loop() {
  buttonState = digitalRead(JS_PIN_SW);
  xValue = analogRead(JS_PIN_X);
  yValue = analogRead(JS_PIN_Y);
  
  //clearDisplay();
  displayDigit(counter);
  
  if (yValue < 300) {
    if (!incremented) {
      --counter;
    }
    incremented = true;
  } else if (yValue > 700) {
    if (!incremented) {
      ++counter;
    }
    incremented = true;
  } else {
    incremented = false;
  }
  
  if (counter < 0) {
    counter = 9;
  } else if (counter > 9) {
    counter = 0;
  }
  
  delay(200);
}
