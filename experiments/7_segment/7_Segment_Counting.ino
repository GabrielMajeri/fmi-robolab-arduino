const byte pinA = 2;
const byte pinB = 3;
const byte pinC = 4;
const byte pinD = 5;
const byte pinE = 6;
const byte pinF = 7;
const byte pinG = 8;
const byte pinDP = 9;

const int DISPLAY_SIZE = 8;
const byte segments[DISPLAY_SIZE] = {
  pinA, pinB, pinC, pinD, pinE, pinF, pinG, pinDP
};

const byte digits[][7] = {
  {1, 1, 1, 1, 1, 1, 0}, // 0
  {0, 1, 1, 0, 0, 0, 0}, // 1
  {1, 1, 0, 1, 1, 0, 1}, // 2
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  {1, 1, 1, 1, 0, 1, 1}, // 9
};

byte currentDigit = 0;
byte dotState = 0;

void clearDisplay() {
  for (int i = 0; i < DISPLAY_SIZE; ++i) {
    digitalWrite(segments[i], LOW);
  }
}

void displayDigit(byte digit) {
  byte* line = digits[digit];
  for (int i = 0; i < DISPLAY_SIZE - 1; ++i) {
    byte segment = segments[i];
    byte state = line[i];
    
    digitalWrite(segment, state);
  }
  
  digitalWrite(pinD, dotState);
}

void setup() {
  for (int i = 0; i < DISPLAY_SIZE; ++i) {
    byte segment = segments[i];
    pinMode(segment, OUTPUT);
  }
}

void loop() {
  clearDisplay();
  displayDigit(currentDigit);
  
  delay(500);
  
  ++currentDigit;
  
  if (currentDigit == 10) {
    currentDigit = 0;
    dotState = !dotState;
  }
}
